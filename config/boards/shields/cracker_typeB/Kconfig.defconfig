## config/boards/shields/cracker_typeB/Kconfig.defconfig
```kconfig
if SHIELD_cracker_R

config ZMK_KEYBOARD_NAME
    default "cracker_R"

config ZMK_SPLIT
    default y

config ZMK_SPLIT_ROLE_CENTRAL
    default y

config ZMK_POINTING
    default y

config PAW3222
    default y

endif

if SHIELD_cracker_L

config ZMK_KEYBOARD_NAME
    default "cracker_L"

config ZMK_SPLIT
    default y

endif
```

## config/boards/shields/cracker_typeB/Kconfig.shield
```kconfig
config SHIELD_cracker_R
    def_bool $(shields_list_contains,cracker_R)

config SHIELD_cracker_L
    def_bool $(shields_list_contains,cracker_L)
```

## config/west.yml
```yaml
manifest:
  remotes:
    - name: zmkfirmware
      url-base: https://github.com/zmkfirmware
    - name: yasio25119915
      url-base: https://github.com/yasio25119915
    - name: kot149
      url-base: https://github.com/kot149
  projects:
    - name: zmk
      remote: zmkfirmware
      revision: v0.3
      import: app/west.yml
    - name: zmk-driver-paw3222
      remote: yasio25119915
      revision: main
    - name: zmk-layout-shift
      remote: kot149
      revision: v2
  self:
    path: config
```
